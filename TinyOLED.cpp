#include "TinyOLED.h"

#define SSD1306_MEMORYMODE 0x20
#define SSD1306_COLUMNADDR 0x21
#define SSD1306_PAGEADDR 0x22
#define SSD1306_SETCONTRAST 0x81
#define SSD1306_CHARGEPUMP 0x8D
#define SSD1306_SEGREMAP 0xA0
#define SSD1306_DISPLAYALLON_RESUME 0xA4
#define SSD1306_DISPLAYALLON 0xA5
#define SSD1306_NORMALDISPLAY 0xA6
#define SSD1306_INVERTDISPLAY 0xA7
#define SSD1306_SETMULTIPLEX 0xA8
#define SSD1306_DISPLAYOFF 0xAE
#define SSD1306_DISPLAYON 0xAF
#define SSD1306_SETPAGE 0xB0
#define SSD1306_COMSCANINC 0xC0
#define SSD1306_COMSCANDEC 0xC8
#define SSD1306_SETDISPLAYOFFSET 0xD3
#define SSD1306_SETDISPLAYCLOCKDIV 0xD5
#define SSD1306_SETPRECHARGE 0xD9
#define SSD1306_SETCOMPINS 0xDA
#define SSD1306_SETVCOMDETECT 0xDB
#define SSD1306_SETLOWCOLUMN 0x00
#define SSD1306_SETHIGHCOLUMN 0x10
#define SSD1306_SETSTARTLINE 0x40

// INSERT FONT ARRAYS HERE
// Example: const uint8_t font5x8[] PROGMEM = { ... };
// Example: const uint8_t font8x8[] PROGMEM = { ... };
const uint8_t Font1206[95][12] PROGMEM = {
  { 0x00, 0x00, 0x00, 0x00, 0x00, 0x00, 0x00, 0x00, 0x00, 0x00, 0x00, 0x00 }, /*" ",0*/
  { 0x00, 0x00, 0x00, 0x00, 0x3F, 0x40, 0x00, 0x00, 0x00, 0x00, 0x00, 0x00 }, /*"!",1*/
  { 0x00, 0x00, 0x30, 0x00, 0x40, 0x00, 0x30, 0x00, 0x40, 0x00, 0x00, 0x00 }, /*""",2*/
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  { 0x40, 0x00, 0x80, 0x00, 0x40, 0x00, 0x20, 0x00, 0x20, 0x00, 0x40, 0x00 }, /*"~",94*/
};

TinyOLED::TinyOLED() : _cursorX(0), _cursorY(0) {
  memset(_buffer, 0, sizeof(_buffer));
}

void TinyOLED::begin(uint8_t address) {
  _address = address;
  Wire.begin();

  sendCommand(0xAE); // display off
  sendCommand(0xD5); // clock
  sendCommand(0x80);
  sendCommand(0xA8); // multiplex
  sendCommand(0x27);
  sendCommand(0xD3); // offset
  sendCommand(0x00);
  sendCommand(0xAD); // internal IREF
  sendCommand(0x30);
  sendCommand(0x8D); // charge pump
  sendCommand(0x14);
  sendCommand(0x40); // start line
  sendCommand(0xA6); // normal display
  sendCommand(0xA4); // display RAM
  sendCommand(0xA1); // seg remap
  sendCommand(0xC8); // com scan dir
  sendCommand(0xDA); // com pins
  sendCommand(0x12);
  sendCommand(0x81); // contrast
  sendCommand(0xAF);
  sendCommand(0xD9); // precharge
  sendCommand(0x22);
  sendCommand(0xDB); // vcomh
  sendCommand(0x20);
  sendCommand(0xAF); // display on

  clear();
  update();
}

void TinyOLED::sendCommand(uint8_t cmd) {
  Wire.beginTransmission(_address);
  Wire.write(0x00);
  Wire.write(cmd);
  Wire.endTransmission();
}

void TinyOLED::sendData(uint8_t data) {
  Wire.beginTransmission(_address);
  Wire.write(0x40);
  Wire.write(data);
  Wire.endTransmission();
}

void TinyOLED::clear() {
  fill(0x00);
}

void TinyOLED::fill(uint8_t pattern) {
  for (uint16_t i = 0; i < sizeof(_buffer); i++) {
    _buffer[i] = pattern;
  }
  update();
}

void TinyOLED::drawPixel(uint8_t x, uint8_t y, uint8_t color) {
  if (x >= OLED_WIDTH || y >= OLED_HEIGHT) return;
  uint16_t index = x + (y / 8) * OLED_WIDTH;
  if (color)
    _buffer[index] |= (1 << (y % 8));
  else
    _buffer[index] &= ~(1 << (y % 8));
}

void TinyOLED::drawRect(uint8_t x1, uint8_t y1, uint8_t x2, uint8_t y2, bool fill, bool invert) {
  if (x1 > x2) { uint8_t t = x1; x1 = x2; x2 = t; }
  if (y1 > y2) { uint8_t t = y1; y1 = y2; y2 = t; }
  if (x2 >= OLED_WIDTH) x2 = OLED_WIDTH - 1;
  if (y2 >= OLED_HEIGHT) y2 = OLED_HEIGHT - 1;

  for (uint8_t y = y1; y <= y2; y++) {
    for (uint8_t x = x1; x <= x2; x++) {
      bool edge = (x == x1 || x == x2 || y == y1 || y == y2);
      bool on = fill ? true : edge;
      uint8_t color = on ? 1 : 0;
      if (invert) color = !color;
      drawPixel(x, y, color);
    }
  }
}

void TinyOLED::setCursor(uint8_t x, uint8_t y) {
  _cursorX = x;
  _cursorY = y;
}

void TinyOLED::testPattern() {
  for (uint8_t page = 0; page < OLED_PAGES; page++) {
    for (uint8_t col = 0; col < OLED_WIDTH; col++) {
      _buffer[col + page * OLED_WIDTH] = col;
    }
  }
  update();
}

void TinyOLED::drawText(uint8_t x, uint8_t y, const char* text, bool invert) {
  setCursor(x, y);

  while (*text) {
    if (_cursorX + 12 > OLED_WIDTH) {
      _cursorX = 0;
      _cursorY += 8;
    }
    if (_cursorY >= OLED_HEIGHT) break;

    drawChar(_cursorX, _cursorY, *text, invert);
    _cursorX += 12;
    text++;
  }
  update();
}

void TinyOLED::update() {
  for (uint8_t page = 0; page < OLED_PAGES; page++) {
    sendCommand(0xB0 + page);
    sendCommand(0x0c);
    sendCommand(0x11);
    for (uint8_t i = 0; i < OLED_WIDTH; i++) {
      sendData(_buffer[i + page * OLED_WIDTH]);
    }
  }
}

void TinyOLED::drawChar(uint8_t x, uint8_t y, char ch, bool invert) {
  uint8_t c = ch - 32;
  if (c > 95) return;
  for (uint8_t i = 0; i < 12; i++) {
    uint8_t line = pgm_read_byte(&Font1206[c][i]);
    if (invert) line = ~line;
    for (uint8_t j = 0; j < 8; j++) {
      drawPixel(x + i, y + j, (line & 0x80) ? 1 : 0);
      line <<= 1;
    }
  }
}
